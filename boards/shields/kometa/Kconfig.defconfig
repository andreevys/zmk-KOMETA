## boards/shields/kometa/Kconfig.defconfig
```kconfig
if SHIELD_KOMETA_LEFT

config ZMK_KEYBOARD_NAME
    default "kometa"

config ZMK_SPLIT_ROLE_CENTRAL
    default y

endif

if SHIELD_KOMETA_DONGLE

config ZMK_KEYBOARD_NAME
    default "kometa"

config ZMK_SPLIT_ROLE_CENTRAL
    default y

# Both halves connect to the dongle as peripherals
config ZMK_SPLIT_BLE_CENTRAL_PERIPHERALS
    default 2

# 5 host profiles + 2 peripherals
config BT_MAX_CONN
    default 7

config BT_MAX_PAIRED
    default 7

endif

if SHIELD_KOMETA_LEFT || SHIELD_KOMETA_RIGHT || SHIELD_KOMETA_DONGLE

config ZMK_SPLIT
    default y

config ZMK_BLE
    default y

endif
```

## config/west.yml
```yaml
manifest:
  remotes:
    - name: zmkfirmware
      url-base: https://github.com/zmkfirmware
    - name: andreevys
      url-base: https://github.com/andreevys
  projects:
    - name: zmk
      remote: zmkfirmware
      revision: 8a44ef109ae301ce084b32dd5fe25200da9e402f
      import: app/west.yml
    - name: prospector-zmk-module
      remote: andreevys
      # fork of carrefinho/prospector-zmk-module feat/new-status-screens,
      # branch "kometa": USB/BT indicator, no blue
      revision: 931a17d9fd39c1a69859292e1f6bb11e8721751d
  self:
    path: config
```

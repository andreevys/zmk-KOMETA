#include "kometa.dtsi"

&kscan0 {
    // Diodes on the left half are soldered reversed (cathode to column),
    // so scan row->col: rows are driven, columns are read (pull-down).
    diode-direction = "row2col";

    col-gpios
        = <&pro_micro 4 (GPIO_ACTIVE_HIGH | GPIO_PULL_DOWN)>   // col0
        , <&pro_micro 5 (GPIO_ACTIVE_HIGH | GPIO_PULL_DOWN)>   // col1
        , <&pro_micro 6 (GPIO_ACTIVE_HIGH | GPIO_PULL_DOWN)>   // col2
        , <&pro_micro 0 (GPIO_ACTIVE_HIGH | GPIO_PULL_DOWN)>   // col3: P1.04 (D8) is dead on this controller, jumpered to D0 (P0.08)
        , <&pro_micro 9 (GPIO_ACTIVE_HIGH | GPIO_PULL_DOWN)>   // col4
        , <&pro_micro 2 (GPIO_ACTIVE_HIGH | GPIO_PULL_DOWN)>   // col5
        ;

    row-gpios
        = <&pro_micro 3 GPIO_ACTIVE_HIGH>    // row0
        , <&pro_micro 7 GPIO_ACTIVE_HIGH>    // row1
        , <&pro_micro 14 GPIO_ACTIVE_HIGH>   // row2: P0.10 (D16) is dead on this controller, bridged to adjacent D14
        , <&pro_micro 10 GPIO_ACTIVE_HIGH>   // row3
        ;
};
